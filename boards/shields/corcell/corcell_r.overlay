#include "corcell.dtsi"

&default_transform {
    col-offset = <6>;
};

&kscan0 {
    compatible = "zmk,kscan-gpio-charlieplex";
    gpios
        = <&gpio0 3 (GPIO_ACTIVE_HIGH)>
        , <&gpio0 28 (GPIO_ACTIVE_HIGH)>
        , <&gpio0 29 (GPIO_ACTIVE_HIGH)>
        , <&gpio1 11 (GPIO_ACTIVE_HIGH)>
        , <&gpio1 15 (GPIO_ACTIVE_HIGH)>
        , <&gpio1 14 (GPIO_ACTIVE_HIGH)>
        ;
    /* Without this the charlieplex driver polls and never arms a GPIO wake
       source, so the central cannot return from deep sleep. Same interrupt
       line as the left half; the PCB matrix is identical. */
    interrupt-gpios = <&gpio1 13 (GPIO_ACTIVE_HIGH | GPIO_PULL_DOWN)>;
};

&spi2 {
    status = "disabled";
};

/* On-board rotary encoder on RE_A/RE_B. An FPC encoder snippet moves these pins. */
&encoder {
    status = "okay";
};
